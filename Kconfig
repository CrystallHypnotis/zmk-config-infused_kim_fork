## dts/bindings/zmk,input-listener-ps2-peripheral.yaml
```yaml
description: |
  PS/2 input listener for peripheral side.
  Accumulates and filters PS/2 mouse events, then re-injects them
  via input_report() for forwarding to central via ZMK_INPUT_SPLIT.

compatible: "zmk,input-listener-ps2-peripheral"

properties:
  device:
    type: phandle
    required: true
    description: The input device (mouse_ps2) to listen on.
  xy-swap:
    type: boolean
  x-invert:
    type: boolean
  y-invert:
    type: boolean
  scale-multiplier:
    type: int
    default: 1
  scale-divisor:
    type: int
    default: 1
  layer-toggle:
    type: int
    default: -1
    required: false
    description: Layer to toggle on mouse movement.
  layer-toggle-delay-ms:
    type: int
    default: 250
  layer-toggle-timeout-ms:
    type: int
    default: 250
```

## dts/bindings/zmk,input-listener-split-central.yaml
```yaml
description: |
  Split central input listener for mouse events forwarded from peripheral.
  Receives input events via ZMK_INPUT_SPLIT and converts them to HID mouse reports.

compatible: "zmk,input-listener-split-central"

properties:
  device:
    type: phandle
    required: true
    description: The input-split device to listen on.
```

## dts/bindings/zmk,input-split.yaml
```yaml
description: |
  Enables split input transport between peripheral and central.
  On peripheral: forwards all input events to the central.
  On central: receives input events from peripherals.

compatible: "zmk,input-split"

properties:
  label:
    type: string
    required: false
    description: Human-readable label.
```
